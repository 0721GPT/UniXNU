// Minimal tree the smoke test patches; not a description of real hardware.
/dts-v1/;

/ {
	compatible = "crabapple,smoke-test";
	model = "CrabApple smoke-test tree";
	#address-cells = <2>;
	#size-cells = <2>;

	chosen {
	};

	crabapple-test {
		marker = "original";
	};
};
